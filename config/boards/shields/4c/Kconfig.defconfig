## config/boards/shields/4c/Kconfig.defconfig
```kconfig
if SHIELD_4C_LEFT

config ZMK_KEYBOARD_NAME
    default "compression 4c"

config ZMK_SPLIT_ROLE_CENTRAL
    default y

config ZMK_USB
    default y

endif

if SHIELD_4C_RIGHT || SHIELD_4C_LEFT

config ZMK_SPLIT
    default y

config ZMK_IDLE_TIMEOUT
    default 300000
    
config ZMK_IDLE_SLEEP_TIMEOUT
    default 1800000

endif
```

## config/west.yml
```yaml
manifest:
  remotes:
    - name: zmk
      url-base: https://github.com/compressionKeyboards
  projects:
    - name: zmk
      remote: zmk
      revision: 3.5
      import: app/west.yml
  self:
    path: config
```
